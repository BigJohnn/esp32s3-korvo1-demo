## main/Kconfig.projbuild
```kconfig
menu "Example Configuration"
    orsource "$IDF_PATH/examples/common_components/env_caps/$IDF_TARGET/Kconfig.env_caps"

    choice EXAMPLE_MODE
        prompt "Example mode"
        default EXAMPLE_MODE_MUSIC
        help
            Select example work mode

        config EXAMPLE_MODE_MUSIC
            bool "music"
        config EXAMPLE_MODE_ECHO
            depends on !EXAMPLE_BSP
            bool "echo"
    endchoice

    choice EXAMPLE_SELECT_MIC_GAIN
        prompt "Set MIC gain"
        depends on EXAMPLE_MODE_ECHO
        default MIC_GAIN_18DB
        help
            Select mic gain for echo mode

        config MIC_GAIN_0DB
            bool "0dB"
        config MIC_GAIN_6DB
            bool "6dB"
        config MIC_GAIN_12DB
            bool "12dB"
        config MIC_GAIN_18DB
            bool "18dB"
        config MIC_GAIN_24DB
            bool "24dB"
        config MIC_GAIN_30DB
            bool "30dB"
        config MIC_GAIN_36DB
            bool "36dB"
        config MIC_GAIN_42DB
            bool "42dB"
    endchoice

    config EXAMPLE_MIC_GAIN
        int
        default 0 if MIC_GAIN_0DB
        default 1 if MIC_GAIN_6DB
        default 2 if MIC_GAIN_12DB
        default 3 if MIC_GAIN_18DB
        default 4 if MIC_GAIN_24DB
        default 5 if MIC_GAIN_30DB
        default 6 if MIC_GAIN_36DB
        default 7 if MIC_GAIN_42DB

    config EXAMPLE_VOICE_VOLUME
        int "Voice volume"
        range 0 100
        default 60
        help
            Set voice volume

    config EXAMPLE_BSP
        bool "Enable Board Support Package (BSP) support"
        default n
        help
            Use BSP to setup all hardware settings. Specific board must be selected in main/idf_component.yml file.

    choice BLINK_LED
        prompt "Blink LED type"
        default BLINK_LED_GPIO
        help
            Select the LED type. A normal level controlled LED or an addressable LED strip.
            The default selection is based on the Espressif DevKit boards.
            You can change the default selection according to your board.

        config BLINK_LED_GPIO
            bool "GPIO"
        config BLINK_LED_STRIP
            bool "LED strip"
    endchoice

    choice BLINK_LED_STRIP_BACKEND
        depends on BLINK_LED_STRIP
        prompt "LED strip backend peripheral"
        default BLINK_LED_STRIP_BACKEND_RMT if SOC_RMT_SUPPORTED
        default BLINK_LED_STRIP_BACKEND_SPI
        help
            Select the backend peripheral to drive the LED strip.

        config BLINK_LED_STRIP_BACKEND_RMT
            depends on SOC_RMT_SUPPORTED
            bool "RMT"
        config BLINK_LED_STRIP_BACKEND_SPI
            bool "SPI"
    endchoice
    
    config BLINK_GPIO
        int "Blink GPIO number"
        range ENV_GPIO_RANGE_MIN ENV_GPIO_OUT_RANGE_MAX
        default 19
        help
            GPIO number (IOxx) to blink on and off the LED.
            Some GPIOs are used for other purposes (flash connections, etc.) and cannot be used to blink.
        
    config BLINK_PERIOD
        int "Blink period in ms"
        range 10 3600000
        default 1000
        help
            Define the blinking period in milliseconds.
endmenu
```
